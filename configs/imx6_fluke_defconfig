## configs/imx6_fluke_defconfig
```kconfig
BR2_arm=y
BR2_cortex_a9=y
BR2_ARM_ENABLE_NEON=y
BR2_ARM_ENABLE_VFP=y
BR2_ARM_FPU_VFPV3=y
BR2_GLOBAL_PATCH_DIR="../../patches"
BR2_TOOLCHAIN_BUILDROOT_GLIBC=y
BR2_GCC_VERSION_11_X=y
BR2_TOOLCHAIN_BUILDROOT_CXX=y
BR2_GCC_ENABLE_LTO=y
BR2_ROOTFS_DEVICE_CREATION_DYNAMIC_EUDEV=y
BR2_ROOTFS_MERGED_USR=y
BR2_TARGET_GENERIC_ROOT_PASSWD="root"
BR2_TARGET_GENERIC_GETTY_PORT="ttymxc0"
BR2_ROOTFS_OVERLAY="../../overlay"
BR2_ROOTFS_POST_BUILD_SCRIPT="../../common/post-build.sh"
BR2_ROOTFS_POST_IMAGE_SCRIPT="../../common/post-image.sh"
BR2_LINUX_KERNEL=y
BR2_LINUX_KERNEL_CUSTOM_VERSION=y
BR2_LINUX_KERNEL_CUSTOM_VERSION_VALUE="5.18.15"
BR2_LINUX_KERNEL_USE_CUSTOM_CONFIG=y
BR2_LINUX_KERNEL_CUSTOM_CONFIG_FILE="board/inspectron/fluke/linux-defconfig"
BR2_LINUX_KERNEL_CONFIG_FRAGMENT_FILES="../../configs/sr_kernel.fragment"
BR2_LINUX_KERNEL_DTS_SUPPORT=y
BR2_LINUX_KERNEL_INTREE_DTS_NAME="imx6q-hummingboard-emmc-som-v15 imx6dl-hummingboard-emmc-som-v15"
BR2_LINUX_KERNEL_CUSTOM_DTS_PATH="board/inspectron/fluke/imx6dl-hummingboard-emmc-som-v15.dts board/inspectron/fluke/imx6q-hummingboard-emmc-som-v15.dts"
BR2_LINUX_KERNEL_NEEDS_HOST_OPENSSL=y
BR2_PACKAGE_BUSYBOX_SHOW_OTHERS=y
BR2_PACKAGE_ALSA_UTILS=y
BR2_PACKAGE_ALSA_UTILS_AMIXER=y
BR2_PACKAGE_ALSA_UTILS_APLAY=y
BR2_PACKAGE_ALSA_UTILS_SPEAKER_TEST=y
BR2_PACKAGE_BLUEZ_ALSA=y
BR2_PACKAGE_BLUEZ_ALSA_HCITOP=y
BR2_PACKAGE_GSTREAMER1=y
BR2_PACKAGE_GST1_PLUGINS_BASE_PLUGIN_VIDEOCONVERT=y
BR2_PACKAGE_GST1_PLUGINS_BASE_PLUGIN_VIDEOTESTSRC=y
BR2_PACKAGE_GST1_PLUGINS_GOOD=y
BR2_PACKAGE_GST1_PLUGINS_GOOD_JPEG=y
BR2_PACKAGE_GST1_PLUGINS_GOOD_PLUGIN_AUTODETECT=y
BR2_PACKAGE_GST1_PLUGINS_GOOD_PLUGIN_MATROSKA=y
BR2_PACKAGE_GST1_PLUGINS_GOOD_PLUGIN_RTP=y
BR2_PACKAGE_GST1_PLUGINS_GOOD_PLUGIN_UDP=y
BR2_PACKAGE_GST1_PLUGINS_GOOD_PLUGIN_V4L2=y
BR2_PACKAGE_GST1_PLUGINS_GOOD_PLUGIN_V4L2_PROBE=y
BR2_PACKAGE_GST1_PLUGINS_BAD_PLUGIN_GEOMETRICTRANSFORM=y
BR2_PACKAGE_GST1_PLUGINS_BAD_PLUGIN_JPEGFORMAT=y
BR2_PACKAGE_GST1_PLUGINS_BAD_PLUGIN_RTP2=y
BR2_PACKAGE_GST1_PLUGINS_BAD_PLUGIN_VIDEOPARSERS=y
BR2_PACKAGE_GST1_PLUGINS_BAD_PLUGIN_KMS=y
BR2_PACKAGE_GST1_PLUGINS_UGLY=y
BR2_PACKAGE_GST1_PLUGINS_UGLY_PLUGIN_X264=y
BR2_PACKAGE_GST1_IMX=y
BR2_PACKAGE_GST1_IMX_IPU=y
BR2_PACKAGE_GST1_IMX_PXP=y
BR2_PACKAGE_GST1_IMX_VPU=y
BR2_PACKAGE_GST1_IMX_V4L2VIDEOSRC=y
BR2_PACKAGE_GST1_IMX_V4L2VIDEOSINK=y
BR2_PACKAGE_GST1_VAAPI=y
BR2_PACKAGE_GST1_VAAPI_ENCODERS=y
BR2_PACKAGE_JQ=y
BR2_PACKAGE_E2FSPROGS=y
BR2_PACKAGE_FB_TEST_APP=y
BR2_PACKAGE_MESA3D=y
BR2_PACKAGE_MESA3D_GALLIUM_DRIVER_ETNAVIV=y
BR2_PACKAGE_MESA3D_OPENGL_EGL=y
BR2_PACKAGE_MESA3D_OPENGL_ES=y
BR2_PACKAGE_QT5=y
BR2_PACKAGE_QT5BASE_SQLITE_QT=y
BR2_PACKAGE_QT5BASE_DBUS=y
BR2_PACKAGE_LINUX_FIRMWARE=y
BR2_PACKAGE_LINUX_FIRMWARE_BRCM_BCM43XX=y
BR2_PACKAGE_LINUX_FIRMWARE_TI_WL18XX=y
BR2_PACKAGE_EDID_DECODE=y
BR2_PACKAGE_EVTEST=y
BR2_PACKAGE_FREESCALE_IMX=y
BR2_PACKAGE_FREESCALE_IMX_PLATFORM_IMX6Q=y
BR2_PACKAGE_IMX_CODEC=y
BR2_PACKAGE_I2C_TOOLS=y
BR2_PACKAGE_LM_SENSORS=y
BR2_PACKAGE_MEMTESTER=y
BR2_PACKAGE_OPENOCD=y
BR2_PACKAGE_PCIUTILS=y
BR2_PACKAGE_PICOCOM=y
BR2_PACKAGE_READ_EDID=y
BR2_PACKAGE_RNG_TOOLS=y
BR2_PACKAGE_RS485CONF=y
BR2_PACKAGE_RTC_TOOLS=y
BR2_PACKAGE_SETSERIAL=y
BR2_PACKAGE_SG3_UTILS=y
BR2_PACKAGE_SG3_UTILS_PROGS=y
BR2_PACKAGE_STATSERIAL=y
BR2_PACKAGE_STM32FLASH=y
BR2_PACKAGE_SYSSTAT=y
BR2_PACKAGE_UBOOT_TOOLS=y
BR2_PACKAGE_UBOOT_TOOLS_FIT_SUPPORT=y
BR2_PACKAGE_UBOOT_TOOLS_FIT_SIGNATURE_SUPPORT=y
BR2_PACKAGE_UBOOT_TOOLS_MKIMAGE=y
BR2_PACKAGE_UBOOT_TOOLS_MKENVIMAGE=y
BR2_PACKAGE_UBOOT_TOOLS_DUMPIMAGE=y
BR2_PACKAGE_PYTHON3=y
BR2_PACKAGE_CA_CERTIFICATES=y
BR2_PACKAGE_LIBDRM_INSTALL_TESTS=y
BR2_PACKAGE_LIBGPIOD=y
BR2_PACKAGE_LIBGPIOD_TOOLS=y
BR2_PACKAGE_LIBUSB=y
BR2_PACKAGE_LIBV4L=y
BR2_PACKAGE_LIBV4L_UTILS=y
BR2_PACKAGE_LIBIMXVPUAPI=y
BR2_PACKAGE_BIND=y
BR2_PACKAGE_BIND_TOOLS=y
BR2_PACKAGE_BLUEZ_TOOLS=y
BR2_PACKAGE_BLUEZ5_UTILS_CLIENT=y
BR2_PACKAGE_CHRONY=y
BR2_PACKAGE_CONNMAN=y
BR2_PACKAGE_CONNMAN_WIFI=y
BR2_PACKAGE_CONNMAN_BLUETOOTH=y
BR2_PACKAGE_DHCPCD=y
BR2_PACKAGE_DNSMASQ=y
BR2_PACKAGE_HOSTAPD=y
BR2_PACKAGE_IW=y
BR2_PACKAGE_OPENSSH=y
BR2_PACKAGE_WIRELESS_REGDB=y
BR2_PACKAGE_WIRELESS_TOOLS=y
BR2_PACKAGE_WIRELESS_TOOLS_LIB=y
BR2_PACKAGE_WPA_SUPPLICANT_WPS=y
BR2_PACKAGE_WPA_SUPPLICANT_CLI=y
BR2_PACKAGE_WPA_SUPPLICANT_PASSPHRASE=y
BR2_PACKAGE_ANDROID_TOOLS=y
BR2_PACKAGE_HTOP=y
BR2_PACKAGE_UTIL_LINUX_HWCLOCK=y
BR2_PACKAGE_UTIL_LINUX_RFKILL=y
BR2_TARGET_ROOTFS_EXT2=y
BR2_TARGET_ROOTFS_EXT2_4=y
BR2_TARGET_ROOTFS_EXT2_SIZE="200M"
BR2_TARGET_UBOOT=y
BR2_TARGET_UBOOT_BUILD_SYSTEM_KCONFIG=y
BR2_TARGET_UBOOT_CUSTOM_VERSION=y
BR2_TARGET_UBOOT_CUSTOM_VERSION_VALUE="2022.04"
BR2_TARGET_UBOOT_BOARD_DEFCONFIG="mx6cuboxi"
BR2_TARGET_UBOOT_NEEDS_OPENSSL=y
BR2_TARGET_UBOOT_FORMAT_IMG=y
BR2_TARGET_UBOOT_SPL=y
BR2_TARGET_UBOOT_SPL_NAME="SPL"
BR2_PACKAGE_HOST_DOSFSTOOLS=y
BR2_PACKAGE_HOST_GENIMAGE=y
BR2_PACKAGE_HOST_MTOOLS=y
```

## configs/imx6_wiscope_murata_defconfig
```kconfig
BR2_arm=y
BR2_cortex_a9=y
BR2_ARM_ENABLE_NEON=y
BR2_ARM_ENABLE_VFP=y
BR2_ARM_FPU_VFPV3=y
BR2_GLOBAL_PATCH_DIR="board/inspectron/wiscopeMurata/patches"
BR2_TOOLCHAIN_BUILDROOT_GLIBC=y
BR2_PACKAGE_HOST_LINUX_HEADERS_CUSTOM_5_15=y
BR2_GCC_VERSION_11_X=y
BR2_TOOLCHAIN_BUILDROOT_CXX=y
BR2_GCC_ENABLE_LTO=y
BR2_PACKAGE_HOST_GDB=y
BR2_ROOTFS_DEVICE_CREATION_DYNAMIC_EUDEV=y
BR2_ROOTFS_MERGED_USR=y
BR2_TARGET_GENERIC_ROOT_PASSWD="root"
BR2_TARGET_GENERIC_GETTY_PORT="ttymxc0"
BR2_ROOTFS_OVERLAY="board/inspectron/wiscopeMurata/overlay"
BR2_ROOTFS_POST_BUILD_SCRIPT="support/scripts/imx6/post-build.sh"
BR2_ROOTFS_POST_IMAGE_SCRIPT="support/scripts/imx6/post-image.sh"
BR2_LINUX_KERNEL=y
BR2_LINUX_KERNEL_CUSTOM_GIT=y
BR2_LINUX_KERNEL_CUSTOM_REPO_URL="https://github.com/Inspectron/linux-imx"
BR2_LINUX_KERNEL_CUSTOM_REPO_VERSION="lf-5.15.y"
BR2_LINUX_KERNEL_USE_CUSTOM_CONFIG=y
BR2_LINUX_KERNEL_CUSTOM_CONFIG_FILE="board/inspectron/wiscopeMurata/wiscope_linux_defconfig"
BR2_LINUX_KERNEL_CONFIG_FRAGMENT_FILES="board/inspectron/wiscopeMurata/sr_kernel.fragment"
BR2_LINUX_KERNEL_DTS_SUPPORT=y
BR2_LINUX_KERNEL_INTREE_DTS_NAME="imx6q-hummingboard-emmc-som-v15 imx6dl-hummingboard-emmc-som-v15 imx6dl-hummingboard2-emmc-som-v15"
BR2_LINUX_KERNEL_CUSTOM_DTS_PATH="board/inspectron/wiscopeMurata/imx6dl-hummingboard2-emmc-som-v15.dts board/inspectron/wiscopeMurata/imx6dl-hummingboard-emmc-som-v15.dts board/inspectron/wiscopeMurata/imx6q-hummingboard-emmc-som-v15.dts"
BR2_LINUX_KERNEL_NEEDS_HOST_OPENSSL=y
BR2_PACKAGE_BUSYBOX_SHOW_OTHERS=y
BR2_PACKAGE_INSPECTRON=y
BR2_PACKAGE_INSPECTRON_INSP_APPS=y
BR2_PACKAGE_INSPRTSPSERVER=y
BR2_PACKAGE_GSTREAMER1=y
BR2_PACKAGE_GST1_PLUGINS_BASE_PLUGIN_VIDEOCONVERT=y
BR2_PACKAGE_GST1_PLUGINS_BASE_PLUGIN_VIDEOTESTSRC=y
BR2_PACKAGE_GST1_PLUGINS_BASE_PLUGIN_PANGO=y
BR2_PACKAGE_GST1_PLUGINS_GOOD_JPEG=y
BR2_PACKAGE_GST1_PLUGINS_GOOD_PLUGIN_AUTODETECT=y
BR2_PACKAGE_GST1_PLUGINS_GOOD_PLUGIN_MATROSKA=y
BR2_PACKAGE_GST1_PLUGINS_GOOD_PLUGIN_RTSP=y
BR2_PACKAGE_GST1_PLUGINS_GOOD_PLUGIN_V4L2=y
BR2_PACKAGE_GST1_PLUGINS_GOOD_PLUGIN_V4L2_PROBE=y
BR2_PACKAGE_GST1_PLUGINS_BAD_PLUGIN_GEOMETRICTRANSFORM=y
BR2_PACKAGE_GST1_PLUGINS_BAD_PLUGIN_JPEGFORMAT=y
BR2_PACKAGE_GST1_PLUGINS_BAD_PLUGIN_RTP2=y
BR2_PACKAGE_GST1_PLUGINS_BAD_PLUGIN_VIDEOPARSERS=y
BR2_PACKAGE_GST1_PLUGINS_BAD_PLUGIN_KMS=y
BR2_PACKAGE_GST1_PLUGINS_UGLY=y
BR2_PACKAGE_GST1_PLUGINS_UGLY_PLUGIN_X264=y
BR2_PACKAGE_GST1_IMX=y
BR2_PACKAGE_GST1_IMX_IPU=y
BR2_PACKAGE_GST1_IMX_PXP=y
BR2_PACKAGE_GST1_IMX_VPU=y
BR2_PACKAGE_GST1_IMX_V4L2VIDEOSRC=y
BR2_PACKAGE_GST1_IMX_V4L2VIDEOSINK=y
BR2_PACKAGE_GST1_RTSP_SERVER=y
BR2_PACKAGE_GST1_VAAPI=y
BR2_PACKAGE_GST1_VAAPI_ENCODERS=y
BR2_PACKAGE_JQ=y
BR2_PACKAGE_DOSFSTOOLS=y
BR2_PACKAGE_DOSFSTOOLS_MKFS_FAT=y
BR2_PACKAGE_E2FSPROGS=y
BR2_PACKAGE_BITSTREAM_VERA=y
BR2_PACKAGE_CANTARELL=y
BR2_PACKAGE_DEJAVU=y
BR2_PACKAGE_FONT_AWESOME=y
BR2_PACKAGE_GHOSTSCRIPT_FONTS=y
BR2_PACKAGE_INCONSOLATA=y
BR2_PACKAGE_LIBERATION=y
BR2_PACKAGE_GLMARK2=y
BR2_PACKAGE_KMSCUBE=y
BR2_PACKAGE_MESA3D_DEMOS=y
BR2_PACKAGE_QT5CINEX=y
BR2_PACKAGE_QT5CINEX_HD=y
BR2_PACKAGE_MESA3D=y
BR2_PACKAGE_MESA3D_GALLIUM_DRIVER_ETNAVIV=y
BR2_PACKAGE_MESA3D_OPENGL_EGL=y
BR2_PACKAGE_MESA3D_OPENGL_ES=y
BR2_PACKAGE_QT5=y
BR2_PACKAGE_QT5BASE_SQLITE_QT=y
BR2_PACKAGE_QT5BASE_FONTCONFIG=y
BR2_PACKAGE_QT5BASE_GIF=y
BR2_PACKAGE_QT5BASE_JPEG=y
BR2_PACKAGE_QT5CONNECTIVITY=y
BR2_PACKAGE_QT5MULTIMEDIA=y
BR2_PACKAGE_QT5QUICKCONTROLS=y
BR2_PACKAGE_QT5QUICKCONTROLS2=y
BR2_PACKAGE_QT5VIRTUALKEYBOARD=y
BR2_PACKAGE_QJSON=y
BR2_PACKAGE_LINUX_FIRMWARE=y
BR2_PACKAGE_LINUX_FIRMWARE_BRCM_BCM43XX=y
BR2_PACKAGE_LINUX_FIRMWARE_BRCM_BCM43XXX=y
BR2_PACKAGE_LINUX_FIRMWARE_TI_WL18XX=y
BR2_PACKAGE_MURATA_CYW_FW=y
BR2_PACKAGE_MURATA_CYW_FW_CYW43455=y
BR2_PACKAGE_MURATA_CYW_FW_CYW43455_1MW=y
BR2_PACKAGE_EDID_DECODE=y
BR2_PACKAGE_EVTEST=y
BR2_PACKAGE_FREESCALE_IMX=y
BR2_PACKAGE_FREESCALE_IMX_PLATFORM_IMX6Q=y
BR2_PACKAGE_IMX_CODEC=y
BR2_PACKAGE_GPTFDISK=y
BR2_PACKAGE_I2C_TOOLS=y
BR2_PACKAGE_LM_SENSORS=y
BR2_PACKAGE_MEMTESTER=y
BR2_PACKAGE_OPENOCD=y
BR2_PACKAGE_PCIUTILS=y
BR2_PACKAGE_PICOCOM=y
BR2_PACKAGE_READ_EDID=y
BR2_PACKAGE_RNG_TOOLS=y
BR2_PACKAGE_RS485CONF=y
BR2_PACKAGE_RTC_TOOLS=y
BR2_PACKAGE_SETSERIAL=y
BR2_PACKAGE_SG3_UTILS=y
BR2_PACKAGE_SG3_UTILS_PROGS=y
BR2_PACKAGE_STATSERIAL=y
BR2_PACKAGE_STM32FLASH=y
BR2_PACKAGE_SYSSTAT=y
BR2_PACKAGE_UBOOT_TOOLS=y
BR2_PACKAGE_UBOOT_TOOLS_FIT_SUPPORT=y
BR2_PACKAGE_UBOOT_TOOLS_FIT_SIGNATURE_SUPPORT=y
BR2_PACKAGE_UBOOT_TOOLS_MKIMAGE=y
BR2_PACKAGE_UBOOT_TOOLS_MKENVIMAGE=y
BR2_PACKAGE_UBOOT_TOOLS_DUMPIMAGE=y
BR2_PACKAGE_PYTHON3=y
BR2_PACKAGE_SBC=y
BR2_PACKAGE_CA_CERTIFICATES=y
BR2_PACKAGE_SQLITE=y
BR2_PACKAGE_LCMS2=y
BR2_PACKAGE_LIBDRM_INSTALL_TESTS=y
BR2_PACKAGE_TIFF=y
BR2_PACKAGE_LIBGPIOD=y
BR2_PACKAGE_LIBGPIOD_TOOLS=y
BR2_PACKAGE_LIBUSB=y
BR2_PACKAGE_LIBV4L=y
BR2_PACKAGE_LIBV4L_UTILS=y
BR2_PACKAGE_LIBIMXVPUAPI=y
BR2_PACKAGE_BOOST=y
BR2_PACKAGE_LIBBSD=y
BR2_PACKAGE_BIND=y
BR2_PACKAGE_BIND_TOOLS=y
BR2_PACKAGE_BLUEZ_TOOLS=y
BR2_PACKAGE_BLUEZ5_UTILS=y
BR2_PACKAGE_BLUEZ5_UTILS_CLIENT=y
BR2_PACKAGE_BLUEZ5_UTILS_MONITOR=y
BR2_PACKAGE_BLUEZ5_UTILS_DEPRECATED=y
BR2_PACKAGE_BLUEZ5_UTILS_TOOLS_HID2HCI=y
BR2_PACKAGE_DHCPCD=y
BR2_PACKAGE_DNSMASQ=y
BR2_PACKAGE_HOSTAPD=y
BR2_PACKAGE_IPTABLES=y
BR2_PACKAGE_IW=y
BR2_PACKAGE_MOSQUITTO=y
BR2_PACKAGE_OPENSSH=y
BR2_PACKAGE_WIRELESS_REGDB=y
BR2_PACKAGE_WIRELESS_TOOLS=y
BR2_PACKAGE_WIRELESS_TOOLS_LIB=y
BR2_PACKAGE_WPA_SUPPLICANT=y
BR2_PACKAGE_WPA_SUPPLICANT_AP_SUPPORT=y
BR2_PACKAGE_WPA_SUPPLICANT_AUTOSCAN=y
BR2_PACKAGE_WPA_SUPPLICANT_EAP=y
BR2_PACKAGE_WPA_SUPPLICANT_WPS=y
BR2_PACKAGE_WPA_SUPPLICANT_CLI=y
BR2_PACKAGE_WPA_SUPPLICANT_WPA_CLIENT_SO=y
BR2_PACKAGE_WPA_SUPPLICANT_PASSPHRASE=y
BR2_PACKAGE_FILE=y
BR2_PACKAGE_ANDROID_TOOLS=y
BR2_PACKAGE_HTOP=y
BR2_PACKAGE_KMOD_TOOLS=y
BR2_PACKAGE_UTIL_LINUX_HWCLOCK=y
BR2_PACKAGE_UTIL_LINUX_RFKILL=y
BR2_TARGET_ROOTFS_EXT2=y
BR2_TARGET_ROOTFS_EXT2_4=y
BR2_TARGET_ROOTFS_EXT2_SIZE="320M"
BR2_TARGET_UBOOT=y
BR2_TARGET_UBOOT_BUILD_SYSTEM_KCONFIG=y
BR2_TARGET_UBOOT_CUSTOM_VERSION=y
BR2_TARGET_UBOOT_CUSTOM_VERSION_VALUE="2022.04"
BR2_TARGET_UBOOT_BOARD_DEFCONFIG="mx6cuboxi"
BR2_TARGET_UBOOT_NEEDS_OPENSSL=y
BR2_TARGET_UBOOT_FORMAT_IMG=y
BR2_TARGET_UBOOT_SPL=y
BR2_TARGET_UBOOT_SPL_NAME="SPL"
BR2_PACKAGE_HOST_DOSFSTOOLS=y
BR2_PACKAGE_HOST_GENIMAGE=y
BR2_PACKAGE_HOST_MTOOLS=y
```

## package/inspectron/Config.in
```kconfig
menuconfig BR2_PACKAGE_INSPECTRON
	bool "Inspectron BSP packages"
	help
		Inspectron BSP Packages & configurations

if BR2_PACKAGE_INSPECTRON
choice
	default BR2_PACKAGE_INSP_WISCOPE_MURATA
	prompt "Inspectron board selection"

config BR2_PACKAGE_INSP_WISCOPE_MURATA
	bool "Inspectron Murata WiScope"
	help
		Use Inspectron's Murata Wiscope

config BR2_PACKAGE_INSP_FLUKE_VAVE
	bool "Inspectron Fluke VAVE"
	help
		Use Inspectron's Fluke VAVE board
endchoice


# BSP packages

# Shared packages with all boards
source "package/inspectron/inspscript/Config.in"
source "package/inspectron/inspapps/Config.in"
source "package/inspectron/inspfonts/Config.in"
endif
```

## package/inspectron/inspapps/Config.in
```kconfig
config BR2_PACKAGE_INSPECTRON_INSP_APPS
	bool "Inspectron Applications"
	help
		Inspectron UserSpace Application & libs that will 
		be installed to the application partition

if BR2_PACKAGE_INSPECTRON_INSP_APPS
	
	# apps
	source "package/inspectron/inspapps/qwirelesscontroller/Config.in"
	source "package/inspectron/inspapps/flukehmi/Config.in"
	source "package/inspectron/inspapps/imagecapturer/Config.in"
	source "package/inspectron/inspapps/traceserver/Config.in"
	source "package/inspectron/inspapps/healthmonitor/Config.in"
	source "package/inspectron/inspapps/qt-gstreamer/Config.in"
	source "package/inspectron/inspapps/insprtspserver/Config.in"
	# libs
	source "package/inspectron/inspapps/libinspCore/Config.in"
	source "package/inspectron/inspapps/libqhttp/Config.in"
	source "package/inspectron/inspapps/libinspFileHandler/Config.in"
	source "package/inspectron/inspapps/libInspHardware/Config.in"
	source "package/inspectron/inspapps/libqmqtt/Config.in"
	# gstreamer plugins
	
	#scripts
	#misc
	
endif
```

## package/inspectron/inspapps/flukehmi/Config.in
```kconfig
config BR2_PACKAGE_FLUKEHMI
	bool "Fluke Demo HMI"
	depends on BR2_PACKAGE_QT5
	help
		qt GUI for the Fluke project

		www.inspectrontools.com
```

## package/inspectron/inspapps/healthmonitor/Config.in
```kconfig
config BR2_PACKAGE_HEALTHMONITOR
	bool "healthmonitor"
	depends on BR2_PACKAGE_QT5
	help
		qt based watchdog for inspectron applications. See README.md for usage

		www.inspectrontools.com
```

## package/inspectron/inspapps/imagecapturer/Config.in
```kconfig
config BR2_PACKAGE_IMAGECAPTURER
	bool "img_capturer"
	depends on BR2_PACKAGE_QT5
	help
		application for capturing images
```

## package/inspectron/inspapps/insprtspserver/Config.in
```kconfig
config BR2_PACKAGE_INSPRTSPSERVER
	bool "rtsp server"
	depends on BR2_PACKAGE_QT5
	help
		a simple application that hosts an rtsp server to stream live video 
		from the imager
```

## package/inspectron/inspapps/libInspHardware/Config.in
```kconfig
config BR2_PACKAGE_LIBINSPHARDWARE
	bool "Inspectron Hardware Communication library"
	depends on BR2_PACKAGE_QT5
	help
		Inspectron hardware communications such as: 
			gpio
			i2c
			spi
		
		www.inspectrontools.com
```

## package/inspectron/inspapps/libinspCore/Config.in
```kconfig
config BR2_PACKAGE_LIBINSPCORE
	bool "Inspectron Core library"
	depends on BR2_PACKAGE_QT5
	help
		Inspectron core library for features such as: 
			console colors
			traceclient support
		
		www.inspectrontools.com
```

## package/inspectron/inspapps/libinspFileHandler/Config.in
```kconfig
config BR2_PACKAGE_LIBINSPFILEHANDLER
	bool "Inspectron File Handler library"
	depends on BR2_PACKAGE_QT5
	help
		Inspectron File handler library for features such as: 
			get file Listing for galleries
			create DCIM dirs
			delete files & DCIM dirs
			get next logical file name for media
		
		www.inspectrontools.com
```

## package/inspectron/inspapps/libqhttp/Config.in
```kconfig
config BR2_PACKAGE_LIBQHTTP
	bool "Inspectron QT HTTP library"
	depends on BR2_PACKAGE_QT5
	help
		Inspectron library for http client/server
		
		www.inspectrontools.com
```

## package/inspectron/inspapps/libqmqtt/Config.in
```kconfig
config BR2_PACKAGE_LIBQMQTT
	bool "QT MQTT Library"
	depends on BR2_PACKAGE_QT5
	help
		Library for connecting as an MQTT client in QT
		
		www.inspectrontools.com
		https://github.com/emqtt/qmqtt
```

## package/inspectron/inspapps/qt-gstreamer/Config.in
```kconfig
config BR2_PACKAGE_QT_GSTREAMER
	bool "qt-gstreamer"
	depends on BR2_PACKAGE_QT5 || BR2_PACKAGE_GSTREAMER1
	help
		video library
		http://gstreamer.freedesktop.org
```
