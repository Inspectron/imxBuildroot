## package/inspectron/inspapps/qwirelesscontroller/Config.in
```kconfig
config BR2_PACKAGE_QWIRELESSCONTROLLER
	bool "qwirelesscontroller"
	depends on BR2_PACKAGE_QT5
	depends on BR2_PACKAGE_LIBQMQTT
	depends on BR2_PACKAGE_LIBQZXING
	help
		qt based handler controller. controls all gpio, leds, imagers, etc.
		also hosts an rtsp server to stream video from connected imagers

		www.inspectrontools.com
```

## package/inspectron/inspapps/traceserver/Config.in
```kconfig
config BR2_PACKAGE_TRACESERVER
	bool "traceserver"
	depends on BR2_PACKAGE_QT5
	help
		qt based server that handles pushes all qDebug, qWarning, & qCritical 
		debug statements into a FIFO that can be fetched remotely over a TCP socket
```

## package/inspectron/inspfonts/Config.in
```kconfig
config BR2_PACKAGE_INSPFONTS
	bool "Inspectron system fonts"
	help
		Inspectron project specific fonts
		
		www.inspectrontools.com

if BR2_PACKAGE_INSPFONTS

config BR2_PACKAGE_INSPFONTS_ROBOTO
	bool "Roboto Bold, Light and Regular fonts"
	default y

config BR2_PACKAGE_INSPFONTS_ROBOTO_LIGHT
	bool "Roboto Light font"
	default y

config BR2_PACKAGE_INSPFONTS_NOTOSANS_CJK_JP
	bool "NotoSans CJK Japanese Bold & Light fonts"
	default y

config BR2_PACKAGE_INSPFONTS_NOTOSANS_CJK_KR
	bool "NotoSans CJK Korean Bold & Light fonts"
	default y

config BR2_PACKAGE_INSPFONTS_NOTOSANS_CJK_SC
	bool "NotoSans CJK Simple Chinese Bold & Light fonts"
	default y

config BR2_PACKAGE_INSPFONTS_NOTOSANS_CJK_TC
	bool "NotoSans CJK Traditional Chinese Bold & Light fonts"
	default y

config BR2_PACKAGE_INSPFONTS_AVENIRLT_STD
	bool "AvenirLTStd-Black, AvenirLTStd-Book, AvenirLTStd-Roman fonts"
	default y

config BR2_PACKAGE_INSPFONTS_FONT_AWESOME
	bool "font-awesome font "
	default n

endif
```

## package/inspectron/inspscript/Config.in
```kconfig
config BR2_PACKAGE_INSPSCRIPT
	bool "Inspectron scripts"
	help
		Inspectron project specific boot & helper scripts
		
		www.inspectrontools.com
```
